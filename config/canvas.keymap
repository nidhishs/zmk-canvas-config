#include <behaviors.dtsi>
#include <dt-bindings/zmk/bt.h>
#include <dt-bindings/zmk/keys.h>
#include <dt-bindings/zmk/outputs.h>

/* Layer Definitions */
#define ALP 0
#define SYM 1
#define NAV 2
#define NUM 3
#define SYS 4
#define ALL ALP SYM NAV // SYS  NUM
/* ---------------- */

#include "zmk-helpers/helper.h"
#include "includes/key-labels.h"
#include "includes/behaviors.dtsi"  // Requires key-labels.
#include "includes/combos.dtsi"     // Requires behaviors.

/* Initialise Behaviors */
WIN_SWAP(LT2)
TAB_SWAP(LT2)
/* ---------------- */

#define XXX &none
#define ___ &trans

/* Global Overrides */
&lt {
    flavor = "balanced";
    quick-tap-ms=<175>;
    tapping-term-ms=<200>;
    retro-tap;
};

/ {
    HAPTIC_OBG(hl_dc_strong_1, &haptic_l, 27)
    HAPTIC_OBG(hr_dc_strong_1, &haptic_r, 27)
    HAPTIC_OBG(hl_strong_click_1, &haptic_l, 1)
    HAPTIC_OBG(hr_strong_click_1, &haptic_r, 1)

    HAPTIC_KEYCODE(haptic_key_b, <0x05>, <&hl_dc_strong_1>, <ALP>)
    HAPTIC_KEYCODE(haptic_key_j, <0x0D>, <&hr_dc_strong_1>, <ALP>)gyg
    HAPTIC_KEYCODE(haptic_lshift, <0xE1>, <&hl_dc_strong_1>, <ALP>)
    HAPTIC_KEYCODE(haptic_rshift, <0xE5>, <&hr_dc_strong_1>, <ALP>)
    HAPTIC_LAYER(haptic_sym, <&hl_strong_click_1>, <SYM>)
    HAPTIC_LAYER(haptic_nav, <&hr_strong_click_1>, <NAV>)
};

ZMK_LAYER(alph,
//  ╭─────────────┬─────────────┬─────────────┬─────────────┬─────────────╮  ╭─────────────┬─────────────┬─────────────┬─────────────┬─────────────╮
      &kp X         &kp Q         &kp M         &kp W         &kp Z            &kp SQT       &kp F         &kp O         &kp U         &kp J     
//  ├─────────────┼─────────────┼─────────────┼─────────────┼─────────────┤  ├─────────────┼─────────────┼─────────────┼─────────────┼─────────────┤
      &kp N         &kp R         &kp T         HML(LSHFT,S)  &kp G            &kp Y         HMR(RSHFT,H)  &kp A         &kp E         &kp I
//  ╰─────────────┼─────────────┼─────────────┼─────────────┼─────────────╯  ╰─────────────┼─────────────┼─────────────┼─────────────┼─────────────╯
                    &kp L         &kp D         &kp C                                        &kp P         &kp COMMA     &kp DOT      
//                ╰─────────────┴─────────────┼─────────────┼─           ─╮  ╭─           ─┼─────────────┼─────────────┴─────────────╯
                                                             &lt SYM SPACE    &lt NAV SPACE 
//                                                          ╰─────────────╯  ╰─────────────╯
)

ZMK_LAYER(symb,
//  ╭─────────────┬─────────────┬─────────────┬─────────────┬─────────────╮  ╭─────────────┬─────────────┬─────────────┬─────────────┬─────────────╮
      &bt_sel       &bt BT_CLR    ___           ___           ___              ___           ___           ___           ___           ___          
//  ├─────────────┼─────────────┼─────────────┼─────────────┼─────────────┤  ├─────────────┼─────────────┼─────────────┼─────────────┼─────────────┤
      OSM(LSHFT)    OSM(LCTRL)    OSM(LALT)     OSM(LGUI)     ___              ___           ___           ___           ___           ___         
//  ╰─────────────┼─────────────┼─────────────┼─────────────┼─────────────╯  ╰─────────────┼─────────────┼─────────────┼─────────────┼─────────────╯
                    ___           ___           ___                                          ___           ___           ___          
//                ╰─────────────┴─────────────┼─────────────┼─           ─╮  ╭─           ─┼─────────────┼─────────────┴─────────────╯
                                                              ___              ___         
//                                                          ╰─────────────╯  ╰─────────────╯
)

ZMK_LAYER(navi,
//  ╭─────────────┬─────────────┬─────────────┬─────────────┬─────────────╮  ╭─────────────┬─────────────┬─────────────┬─────────────┬─────────────╮
      ___           ___           ___           ___           ___              ___           ___           ___           ___           ___          
//  ├─────────────┼─────────────┼─────────────┼─────────────┼─────────────┤  ├─────────────┼─────────────┼─────────────┼─────────────┼─────────────┤
      ___           ___           ___           ___           ___              ___           OSM(LGUI)     OSM(LALT)     OSM(LCTRL)    OSM(LSHFT)  
//  ╰─────────────┼─────────────┼─────────────┼─────────────┼─────────────╯  ╰─────────────┼─────────────┼─────────────┼─────────────┼─────────────╯
                    ___           ___           ___                                          ___           ___           ___          
//                ╰─────────────┴─────────────┼─────────────┼─           ─╮  ╭─           ─┼─────────────┼─────────────┴─────────────╯
                                                              ___              ___         
//                                                          ╰─────────────╯  ╰─────────────╯
)